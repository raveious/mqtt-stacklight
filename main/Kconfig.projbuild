## main/Kconfig.projbuild
```kconfig
menu "Project Configuration"

config BROKER_URL
    string "Broker URL"
    default "mqtt://iot.eclipse.org"
    help
        URL of the broker to connect to

config WIFI_SSID
    string "WiFi SSID"
    help
        SSID (network name) for the example to connect to.

config WIFI_PASSWORD
    string "WiFi Password"
    help
        WiFi password (WPA or WPA2) for the example to use.

endmenu
```
